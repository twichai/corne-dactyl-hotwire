## config/boards/corne/Kconfig.shield
```kconfig
# No whitespace after the comma or in your part name!
config CORNE_LEFT
    def_bool $(shields_list_contains,coren_left)

# No whitespace after the comma or in your part name!
config CORNE_RIGHT
    def_bool $(shields_list_contains,corne_right)
```

## config/boards/shields/dcorne/Kconfig.defconfig
```kconfig
if DCORNE_LEFT

# Name must be less than 16 characters long!
config ZMK_KEYBOARD_NAME
    default "dcorne"

config ZMK_SPLIT_ROLE_CENTRAL
    default y

endif

if DCORNE_LEFT || DCORNE_RIGHT

config ZMK_SPLIT
    default y

endif
```

## config/boards/shields/dcorne/Kconfig.shield
```kconfig
# No whitespace after the comma or in your part name!
config DCORNE_LEFT
    def_bool $(shields_list_contains,dcorne_left)

# No whitespace after the comma or in your part name!
config DCORNE_RIGHT
    def_bool $(shields_list_contains,dcorne_right)
```
